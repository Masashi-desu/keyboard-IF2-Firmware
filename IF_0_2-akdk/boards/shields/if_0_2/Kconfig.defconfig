## IF_0_2-akdk/boards/shields/if_0_2/Kconfig.defconfig
```kconfig
if SHIELD_IF_0_2_LEFT

config ZMK_KEYBOARD_NAME
    default "if_0_2"

endif

if SHIELD_IF_0_2_LEFT || SHIELD_IF_0_2_RIGHT

config ZMK_SPLIT
    default y

endif
```

## boards/shields/if_0_2/Kconfig.shield
```kconfig
config SHIELD_IF_0_2_LEFT
    def_bool $(shields_list_contains,if_0_2_left)
config SHIELD_IF_0_2_RIGHT
    def_bool $(shields_list_contains,if_0_2_right)
```
